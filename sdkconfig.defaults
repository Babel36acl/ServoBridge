## sdkconfig.defaults
```kconfig
# 目标芯片
CONFIG_IDF_TARGET="esp32c6"

# 控制台走 USB Serial/JTAG（板上 Type-C），把 UART0 完整让给 RS485
CONFIG_ESP_CONSOLE_USB_SERIAL_JTAG=y
CONFIG_ESP_CONSOLE_SECONDARY_NONE=y

# BLE：仅 NimBLE 外设角色，单连接
CONFIG_BT_ENABLED=y
CONFIG_BT_NIMBLE_ENABLED=y
CONFIG_BT_NIMBLE_ROLE_PERIPHERAL=y
CONFIG_BT_NIMBLE_MAX_CONNECTIONS=1
CONFIG_BT_NIMBLE_ATT_PREFERRED_MTU=256
CONFIG_BT_NIMBLE_NVS_PERSIST=y

# 日志级别：INFO 足够，走 USB，不碰 UART0
CONFIG_LOG_DEFAULT_LEVEL_INFO=y
```
